## kernel/configs/steamphone_exynos990_defconfig
```kconfig
# SteamPhone Kernel Configuration - Exynos 990 (Galaxy S20 FE SM-G780F)
# Based on mainline Linux 6.6.x with Samsung Exynos 990 support
#
# This defconfig enables the minimum required subsystems for SteamOS on ARM.

# --- Architecture ---
CONFIG_ARM64=y
CONFIG_ARCH_EXYNOS=y

# --- SoC: Exynos 990 ---
CONFIG_SOC_EXYNOS990=y
CONFIG_EXYNOS_CHIPID=y
CONFIG_EXYNOS_PMU=y
CONFIG_EXYNOS_USI=y

# --- CPU ---
CONFIG_SMP=y
CONFIG_NR_CPUS=8
CONFIG_HZ_300=y
CONFIG_ARM64_ERRATUM_LIST=y
CONFIG_SCHED_MC=y
CONFIG_ENERGY_MODEL=y

# --- Memory ---
CONFIG_TRANSPARENT_HUGEPAGE=y
CONFIG_ZSWAP=y
CONFIG_ZRAM=y
CONFIG_ZSMALLOC=y

# --- Power Management ---
CONFIG_PM=y
CONFIG_PM_SLEEP=y
CONFIG_SUSPEND=y
CONFIG_CPU_FREQ=y
CONFIG_CPU_FREQ_GOV_PERFORMANCE=y
CONFIG_CPU_FREQ_GOV_SCHEDUTIL=y
CONFIG_ARM_EXYNOS_CPUFREQ=y
CONFIG_ARM_SCMI_CPUFREQ=y
CONFIG_DEVFREQ_GOV_SIMPLE_ONDEMAND=y
CONFIG_THERMAL=y
CONFIG_EXYNOS_THERMAL=y
CONFIG_CPU_IDLE=y
CONFIG_ARM_EXYNOS_CPUIDLE=y

# --- GPU: Mali-G77 MP11 (Panfrost) ---
CONFIG_DRM=y
CONFIG_DRM_PANFROST=y
CONFIG_DRM_SCHED=y
CONFIG_DRM_GEM_SHMEM_HELPER=y
CONFIG_GPU_MALI_PANFROST=y

# --- Display: Samsung AMOLED (6.5" FHD+ 120Hz) ---
CONFIG_DRM_SAMSUNG=y
CONFIG_DRM_SAMSUNG_DECON=y
CONFIG_DRM_SAMSUNG_DSI=y
CONFIG_DRM_PANEL_SAMSUNG_S6E3FC3=y
CONFIG_BACKLIGHT_CLASS_DEVICE=y
CONFIG_DRM_FBDEV_EMULATION=y

# --- Framebuffer (fallback/boot) ---
CONFIG_FB=y
CONFIG_FB_SIMPLE=y
CONFIG_FRAMEBUFFER_CONSOLE=y

# --- Input: Touchscreen ---
CONFIG_INPUT_TOUCHSCREEN=y
CONFIG_TOUCHSCREEN_SEC_TS=y
CONFIG_INPUT_EVDEV=y
CONFIG_INPUT_UINPUT=y

# --- Audio ---
CONFIG_SOUND=y
CONFIG_SND=y
CONFIG_SND_SOC=y
CONFIG_SND_SOC_SAMSUNG=y
CONFIG_SND_SOC_SAMSUNG_ABOX=y
CONFIG_SND_SOC_CS47L93=y

# --- Storage ---
CONFIG_SCSI=y
CONFIG_BLK_DEV_SD=y
CONFIG_SCSI_UFS=y
CONFIG_SCSI_UFS_EXYNOS=y
CONFIG_MMC=y
CONFIG_MMC_SDHCI=y
CONFIG_MMC_SDHCI_EXYNOS=y

# --- USB ---
CONFIG_USB=y
CONFIG_USB_DWC3=y
CONFIG_USB_DWC3_EXYNOS=y
CONFIG_USB_GADGET=y
CONFIG_USB_CONFIGFS=y
CONFIG_USB_ROLE_SWITCH=y
CONFIG_TYPEC=y
CONFIG_TYPEC_SAMSUNG=y

# --- Wireless: WiFi ---
CONFIG_CFG80211=y
CONFIG_MAC80211=y
CONFIG_WLAN=y
CONFIG_WLAN_VENDOR_SAMSUNG=y
CONFIG_BCMDHD=m
CONFIG_BCM4375=y

# --- Bluetooth ---
CONFIG_BT=y
CONFIG_BT_HCIUART=y
CONFIG_BT_BCM=y

# --- Cellular Modem ---
CONFIG_SAMSUNG_CP=y
CONFIG_EXYNOS_MODEM=y
CONFIG_LINK_DEVICE_SHMEM=y

# --- Sensors ---
CONFIG_IIO=y
CONFIG_IIO_BUFFER=y
CONFIG_IIO_TRIGGERED_BUFFER=y
CONFIG_INV_MPU6050_IIO=y
CONFIG_AK8975=y
CONFIG_BMP280=y
CONFIG_GP2AP002=y

# --- Battery / Charger ---
CONFIG_POWER_SUPPLY=y
CONFIG_CHARGER_MAX77705=y
CONFIG_FUELGAUGE_MAX77705=y
CONFIG_BATTERY_SAMSUNG=y

# --- Camera (optional, low priority) ---
# CONFIG_VIDEO_SAMSUNG_EXYNOS_IS is not set

# --- Filesystem ---
CONFIG_EXT4_FS=y
CONFIG_F2FS_FS=y
CONFIG_BTRFS_FS=y
CONFIG_TMPFS=y
CONFIG_PROC_FS=y
CONFIG_SYSFS=y
CONFIG_DEVTMPFS=y
CONFIG_DEVTMPFS_MOUNT=y
CONFIG_FUSE_FS=y
CONFIG_OVERLAY_FS=y

# --- Networking ---
CONFIG_NET=y
CONFIG_INET=y
CONFIG_IPV6=y
CONFIG_NETFILTER=y
CONFIG_BRIDGE=y
CONFIG_VLAN_8021Q=y

# --- Containers / Namespaces (for flatpak/steam) ---
CONFIG_NAMESPACES=y
CONFIG_USER_NS=y
CONFIG_PID_NS=y
CONFIG_NET_NS=y
CONFIG_CGROUPS=y
CONFIG_CGROUP_DEVICE=y
CONFIG_CGROUP_FREEZER=y
CONFIG_CGROUP_SCHED=y
CONFIG_CPUSETS=y
CONFIG_MEMCG=y
CONFIG_SECCOMP=y

# --- Misc ---
CONFIG_PRINTK=y
CONFIG_SERIAL_SAMSUNG=y
CONFIG_SERIAL_SAMSUNG_CONSOLE=y
CONFIG_WATCHDOG=y
CONFIG_S3C2410_WATCHDOG=y
CONFIG_RTC_CLASS=y
CONFIG_RTC_DRV_S2MPS11=y
CONFIG_REGULATOR=y
CONFIG_REGULATOR_S2MPS11=y
CONFIG_MFD_SEC_CORE=y
CONFIG_PINCTRL=y
CONFIG_PINCTRL_EXYNOS=y
CONFIG_GPIO_SAMSUNG=y

# --- Security ---
CONFIG_SECURITY=y
CONFIG_SECURITY_APPARMOR=y
CONFIG_DEFAULT_SECURITY_APPARMOR=y
CONFIG_CRYPTO_AES=y
CONFIG_CRYPTO_SHA256=y
CONFIG_CRYPTO_SHA512=y

# --- Debug (development only) ---
CONFIG_DYNAMIC_DEBUG=y
CONFIG_DEBUG_INFO=y
CONFIG_EARLY_PRINTK=y
CONFIG_SERIAL_EARLYCON=y
```

## kernel/configs/steamphone_sd865_defconfig
```kconfig
# SteamPhone Kernel Configuration - Snapdragon 865 (Galaxy S20 FE SM-G780G)
# Based on mainline Linux 6.6.x with Qualcomm SM8250 support
#
# This defconfig enables the minimum required subsystems for SteamOS on ARM.

# --- Architecture ---
CONFIG_ARM64=y
CONFIG_ARCH_QCOM=y

# --- SoC: Snapdragon 865 (SM8250) ---
CONFIG_QCOM_SMEM=y
CONFIG_QCOM_SCM=y
CONFIG_QCOM_RPMH=y
CONFIG_QCOM_PDC=y
CONFIG_QCOM_SOCINFO=y

# --- CPU ---
CONFIG_SMP=y
CONFIG_NR_CPUS=8
CONFIG_HZ_300=y
CONFIG_SCHED_MC=y
CONFIG_ENERGY_MODEL=y

# --- Memory ---
CONFIG_TRANSPARENT_HUGEPAGE=y
CONFIG_ZSWAP=y
CONFIG_ZRAM=y
CONFIG_ZSMALLOC=y

# --- Power Management ---
CONFIG_PM=y
CONFIG_PM_SLEEP=y
CONFIG_SUSPEND=y
CONFIG_CPU_FREQ=y
CONFIG_CPU_FREQ_GOV_PERFORMANCE=y
CONFIG_CPU_FREQ_GOV_SCHEDUTIL=y
CONFIG_ARM_QCOM_CPUFREQ=y
CONFIG_QCOM_CPUFREQ_HW=y
CONFIG_THERMAL=y
CONFIG_QCOM_TSENS=y
CONFIG_CPU_IDLE=y
CONFIG_ARM_PSCI_CPUIDLE=y

# --- GPU: Adreno 650 (Freedreno) ---
CONFIG_DRM=y
CONFIG_DRM_MSM=y
CONFIG_DRM_SCHED=y
CONFIG_QCOM_ADRENO_GPU=y

# --- Display: Samsung AMOLED ---
CONFIG_DRM_MSM_DSI=y
CONFIG_DRM_PANEL_SAMSUNG_S6E3FC3=y
CONFIG_BACKLIGHT_CLASS_DEVICE=y
CONFIG_DRM_FBDEV_EMULATION=y

# --- Framebuffer ---
CONFIG_FB=y
CONFIG_FB_SIMPLE=y
CONFIG_FRAMEBUFFER_CONSOLE=y

# --- Input: Touchscreen ---
CONFIG_INPUT_TOUCHSCREEN=y
CONFIG_TOUCHSCREEN_SEC_TS=y
CONFIG_INPUT_EVDEV=y
CONFIG_INPUT_UINPUT=y

# --- Audio ---
CONFIG_SOUND=y
CONFIG_SND=y
CONFIG_SND_SOC=y
CONFIG_SND_SOC_QCOM=y
CONFIG_SND_SOC_SM8250=y
CONFIG_QCOM_APR=y
CONFIG_SND_SOC_QDSP6=y

# --- Storage ---
CONFIG_SCSI=y
CONFIG_BLK_DEV_SD=y
CONFIG_SCSI_UFS=y
CONFIG_SCSI_UFS_QCOM=y
CONFIG_MMC=y
CONFIG_MMC_SDHCI=y
CONFIG_MMC_SDHCI_MSM=y

# --- USB ---
CONFIG_USB=y
CONFIG_USB_DWC3=y
CONFIG_USB_DWC3_QCOM=y
CONFIG_USB_GADGET=y
CONFIG_USB_CONFIGFS=y
CONFIG_USB_ROLE_SWITCH=y
CONFIG_TYPEC=y
CONFIG_TYPEC_QCOM_PMIC=y

# --- Wireless: WiFi ---
CONFIG_CFG80211=y
CONFIG_MAC80211=y
CONFIG_WLAN=y
CONFIG_ATH11K=y
CONFIG_ATH11K_PCI=y

# --- Bluetooth ---
CONFIG_BT=y
CONFIG_BT_HCIUART=y
CONFIG_BT_QCA=y

# --- Cellular Modem ---
CONFIG_QCOM_QMI_HELPERS=y
CONFIG_MHI_BUS=y
CONFIG_MHI_BUS_PCI_GENERIC=y
CONFIG_QRTR=y
CONFIG_QRTR_SMD=y

# --- Sensors ---
CONFIG_IIO=y
CONFIG_IIO_BUFFER=y
CONFIG_IIO_TRIGGERED_BUFFER=y
CONFIG_INV_MPU6050_IIO=y
CONFIG_AK8975=y
CONFIG_BMP280=y

# --- Battery / Charger ---
CONFIG_POWER_SUPPLY=y
CONFIG_CHARGER_QCOM_SMBB=y
CONFIG_FUEL_GAUGE_QCOM=y

# --- Filesystem ---
CONFIG_EXT4_FS=y
CONFIG_F2FS_FS=y
CONFIG_BTRFS_FS=y
CONFIG_TMPFS=y
CONFIG_PROC_FS=y
CONFIG_SYSFS=y
CONFIG_DEVTMPFS=y
CONFIG_DEVTMPFS_MOUNT=y
CONFIG_FUSE_FS=y
CONFIG_OVERLAY_FS=y

# --- Networking ---
CONFIG_NET=y
CONFIG_INET=y
CONFIG_IPV6=y
CONFIG_NETFILTER=y
CONFIG_BRIDGE=y
CONFIG_VLAN_8021Q=y

# --- Containers / Namespaces ---
CONFIG_NAMESPACES=y
CONFIG_USER_NS=y
CONFIG_PID_NS=y
CONFIG_NET_NS=y
CONFIG_CGROUPS=y
CONFIG_CGROUP_DEVICE=y
CONFIG_CGROUP_FREEZER=y
CONFIG_CGROUP_SCHED=y
CONFIG_CPUSETS=y
CONFIG_MEMCG=y
CONFIG_SECCOMP=y

# --- Misc ---
CONFIG_PRINTK=y
CONFIG_SERIAL_MSM=y
CONFIG_SERIAL_MSM_CONSOLE=y
CONFIG_WATCHDOG=y
CONFIG_QCOM_WDT=y
CONFIG_RTC_CLASS=y
CONFIG_RTC_DRV_PM8XXX=y
CONFIG_REGULATOR=y
CONFIG_REGULATOR_QCOM_RPMH=y
CONFIG_PINCTRL=y
CONFIG_PINCTRL_SM8250=y
CONFIG_QCOM_SPMI_PMIC=y
CONFIG_SPMI=y
CONFIG_QCOM_SPMI_BUS=y

# --- Security ---
CONFIG_SECURITY=y
CONFIG_SECURITY_APPARMOR=y
CONFIG_DEFAULT_SECURITY_APPARMOR=y
CONFIG_CRYPTO_AES=y
CONFIG_CRYPTO_SHA256=y
CONFIG_CRYPTO_SHA512=y

# --- Debug (development only) ---
CONFIG_DYNAMIC_DEBUG=y
CONFIG_DEBUG_INFO=y
CONFIG_EARLY_PRINTK=y
CONFIG_SERIAL_EARLYCON=y
```
